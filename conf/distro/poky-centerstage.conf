## conf/distro/poky-centerstage.conf
```bitbake
require conf/distro/poky.conf

POKY_VERSION := "23.0"
DISTRO = "poky-centerstage"
DISTRO_NAME = "Poky Centerstage (Castboard Centerstage Linux Distro)"
DISTRO_VERSION = "1.0.0"

# Jwinarske stuff - https://github.com/jwinarske/meta-flutter
# With the addition of wayland.
BBMASK = "meta-networking/recipes-kernel/wireguard"
DISTRO_FEATURES_remove = " sysvinit"
DISTRO_FEATURES_append = " alsa bluetooth usbhost opengl vulkan systemd wifi wayland"
DISTRO_FEATURES_append=" pam selinux polkit"
DISTRO_FEATURES_BACKFILL_CONSIDERED = ""
COMBINED_FEATURES += "alsa "
MACHINE_FEATURES_remove = "apm"

INIT_MANAGER = "systemd"
VIRTUAL-RUNTIME_init_manager = "systemd"
VIRTUAL-RUNTIME_initscripts = ""

PREFERRED_PROVIDER_jpeg = "libjpeg-turbo"
PREFERRED_PROVIDER_jpeg-native = "libjpeg-turbo-native"
```
